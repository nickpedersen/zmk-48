## config/boards/shields/naked48/Kconfig.defconfig
```kconfig
# Copyright (c) 2020 The ZMK Contributors
# SPDX-License-Identifier: MIT

if SHIELD_NAKED48

CONFIG_ZMK_RGB_UNDERGLOW=y
CONFIG_WS2812_STRIP=y

config ZMK_KEYBOARD_NAME
    default "Nick Keyboard"

endif 
```
